## Kconfig
```kconfig
# Copyright (c) 2026 amgskobo
# SPDX-License-Identifier: MIT

rsource "drivers/Kconfig"

config ZMK_INPUT_ABS2REL_LOG_LEVEL
    int "zmk-input-abs2rel log level (0 off, 1 error, 2 warning, 3 info, 4 debug)"
    range 0 4
    default 3
    help
      Logs contain operational state and numeric diagnostics, never input
      contents, user labels, peer addresses or authentication material.
```

## drivers/input/Kconfig
```kconfig
# SPDX-License-Identifier: MIT
DT_COMPAT_ZMK_INPUT_PROCESSOR_ABSOLUTE_TO_RELATIVE := zmk,input-processor-absolute-to-relative
config ZMK_INPUT_PROCESSOR_ABSOLUTE_TO_RELATIVE
    bool
    default $(dt_compat_enabled,$(DT_COMPAT_ZMK_INPUT_PROCESSOR_ABSOLUTE_TO_RELATIVE))
    depends on ZMK_POINTING
    depends on !ZMK_SPLIT || ZMK_SPLIT_ROLE_CENTRAL

config ZMK_INPUT_ABS2REL_MAX_SOURCES
    int "Reserved abs2rel source indices (0 for all listeners)"
    depends on ZMK_INPUT_PROCESSOR_ABSOLUTE_TO_RELATIVE
    range 0 256
    default 0
    help
      Zero preserves independent histories for every enabled ZMK input listener,
      with at least source zero for callers without a processor state. A positive
      value reserves the original global indices zero through this value minus
      one for every converter node. Indices are not remapped: sparse references
      require their full range. Enabled listeners whose devices are enabled have
      their base and all child routes checked at build time. Direct callers must
      also fit the selected bound; out-of-range events pass through unchanged.
      Verify effective DTS indices and direct callers before selecting a smaller
      board-specific bound. The default preserves generic source capacity.
```

## dts/bindings/zmk,input-processor-absolute-to-relative.yaml
```yaml
# SPDX-License-Identifier: MIT
description: Absolute-to-relative conversion with independent listener histories
compatible: "zmk,input-processor-absolute-to-relative"
include: ip_zero_param.yaml
```

## tests/integration/firmware/boards/shields/abs2rel_test/Kconfig.defconfig
```kconfig
# Copyright (c) 2026 amgskobo
# SPDX-License-Identifier: MIT

if SHIELD_ABS2REL_TEST

config ZMK_KEYBOARD_NAME
    default "Abs2rel Test"

endif
```

## tests/integration/firmware/boards/shields/abs2rel_test/Kconfig.shield
```kconfig
# Copyright (c) 2026 amgskobo
# SPDX-License-Identifier: MIT

config SHIELD_ABS2REL_TEST
    def_bool $(shields_list_contains,abs2rel_test)
```
