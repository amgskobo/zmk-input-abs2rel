/* SPDX-License-Identifier: MIT */
/ {
    zip_absolute_to_relative: abs_rel {
        status = "okay";
        compatible = "zmk,input-processor-absolute-to-relative";
        #input-processor-cells = <0>;
    };
    /* Optional legacy instance: enable explicitly only for separate history. */
    zip_absolute_to_relative_scroll: abs_rel_scroll {
        status = "disabled";
        compatible = "zmk,input-processor-absolute-to-relative";
        #input-processor-cells = <0>;
    };
};
