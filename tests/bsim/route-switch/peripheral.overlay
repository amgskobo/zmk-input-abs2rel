/*
 * Copyright (c) 2026 amgskobo
 * SPDX-License-Identifier: MIT
 *
 * A touchpad on the peripheral, as ZMK's input mock: one frame every 100 ms,
 * each ending in a sync, from 4.0 s on. The layer switches of
 * nrf52_bsim.keymap fall between the frames marked below.
 */

#include <zephyr/dt-bindings/input/input-event-codes.h>

#include "shared.dtsi"

&kscan {
    /delete-property/ exit-after;
    events = <>;
};

/ {
    mock_pad: mock_pad {
        compatible = "zmk,input-mock";
        status = "okay";
        event-startup-delay = <4000>;
        event-period = <100>;
        events
            /* 4.0 s: the contact lands - a reference. */
            = <INPUT_EV_KEY INPUT_BTN_TOUCH 1 0>
            , <INPUT_EV_ABS INPUT_ABS_X 100 0>
            , <INPUT_EV_ABS INPUT_ABS_Y 100 1>
            /* 4.1 s: (5, 5). */
            , <INPUT_EV_ABS INPUT_ABS_X 110 0>
            , <INPUT_EV_ABS INPUT_ABS_Y 110 1>
            /* 4.2 s: (10, 10). */
            , <INPUT_EV_ABS INPUT_ABS_X 120 0>
            , <INPUT_EV_ABS INPUT_ABS_Y 120 1>
            /* 4.3 s: a click, which the default route passes. */
            , <INPUT_EV_KEY INPUT_BTN_0 1 1>
            /* 4.4 s: (10, 10). Layer 1 goes up at 4.45 s. */
            , <INPUT_EV_ABS INPUT_ABS_X 130 0>
            , <INPUT_EV_ABS INPUT_ABS_Y 130 1>
            /* 4.5 s: a new reference on the other converter. */
            , <INPUT_EV_ABS INPUT_ABS_X 140 0>
            , <INPUT_EV_ABS INPUT_ABS_Y 140 1>
            /* 4.6 s: (5, 5). */
            , <INPUT_EV_ABS INPUT_ABS_X 150 0>
            , <INPUT_EV_ABS INPUT_ABS_Y 150 1>
            /* 4.7 s: the click's release must reach the host. Layer 1 drops
             * at 4.75 s. */
            , <INPUT_EV_KEY INPUT_BTN_0 0 1>
            /* 4.8 s: a new reference back on the default converter. */
            , <INPUT_EV_ABS INPUT_ABS_X 160 0>
            , <INPUT_EV_ABS INPUT_ABS_Y 160 1>
            /* 4.9 s: (5, 5). */
            , <INPUT_EV_ABS INPUT_ABS_X 170 0>
            , <INPUT_EV_ABS INPUT_ABS_Y 170 1>
            /* 5.0 s: lift. Layer 1 goes up at 5.05 s. */
            , <INPUT_EV_KEY INPUT_BTN_TOUCH 0 1>
            /* 5.1 s and 5.2 s: a click made wholly on layer 1 stays there.
             * Layer 1 drops at 5.25 s. */
            , <INPUT_EV_KEY INPUT_BTN_0 1 1>
            , <INPUT_EV_KEY INPUT_BTN_0 0 1>
            ;
    };
};

&split_input {
    device = <&mock_pad>;
};
