/* SPDX-License-Identifier: MIT */
/* Keep the same two converter listeners; disabled core mouse-key listeners
 * leave their actual callback indices at zero and one. */
&mkp_input_listener { status = "disabled"; };
&mmv_input_listener { status = "disabled"; };
&msc_input_listener { status = "disabled"; };
