/* SPDX-License-Identifier: MIT */
#include "low.overlay"
/ {
    disabled_source: disabled_source { status = "disabled"; };
    excluded_listener {
        compatible = "zmk,input-listener";
        device = <&disabled_source>;
        input-processors = <&zip_absolute_to_relative>;
        child { layers = <1>; input-processors = <&zip_absolute_to_relative>; };
    };
};
